## board/linuxhost/configs/defconfig
```kconfig
##
## Copyright (C) 2016 YunOS Project. All rights reserved.
##

## chip&version configs
CONFIG_CHIP_COMPILE_PREFIX=
CONFIG_CHIP_VERSION=linuxhost
CONFIG_CHIP_ARCH=linux

## system info
CONFIG_PRODUCT_NAME=ALI_YUNOS_YOC_LINUXHOST
CONFIG_SYSINFO_FACTORY_ID=9999
CONFIG_SYSINFO_PRODUCT_MODEL=ALI_YUNOS_YOC_LINUXHOST
CONFIG_SYSINFO_PRODUCT_TYPE=ALI_YUNOS_YOC_LINUXHOST
CONFIG_SYSINFO_PRODUCT_INTERNAL_TYPE=ALI_YUNOS_YOC_LINUXHOST1R
CONFIG_SYSINFO_DEVICE_TYPE=dev-codebase
CONFIG_SYSINFO_TERMINAL_TYPE=internal_model-codebase
CONFIG_SYSINFO_OS_VERSION=5.6.0-R
CONFIG_SYSINFO_OS_INNERVERSION=5.6.0

## component configs
CONFIG_YOC_FRAMEWORK=y
CONFIG_YOC_ID2JS=y
CONFIG_YOC_ID2JS_SNAPSHOT=y
CONFIG_YOC_ID2KERNEL=y
CONFIG_YOC_UKERNEL=y
CONFIG_YOC_RHINO=y
CONFIG_YOC_NET_PROTOCOL=n
CONFIG_YOC_SSL=n
CONFIG_YOC_PRODUCT=y
CONFIG_YOS_LPM=n
CONFIG_YOC_YSH=y
CONFIG_YSH_CMD_TEST=y

CONFIG_YOC_URADAR_MESH=n
CONFIG_YOC_DDA=n
CONFIG_YOC_DDM=n

## wifi netconf configs
CONFIG_WIFI_USE_DEFAULT_AP=n
CONFIG_WIFI_AUTO_CONFIG=n

## yoc-core-tfs configs
CONFIG_LIB_IDTFS=y
CONFIG_TFS_ID2_RSA=n
CONFIG_TFS_ID2_3DES=y
CONFIG_TFS_ID2_STORAGE=n
CONFIG_TFS_EMULATE=y
CONFIG_TFS_MBEDTLS=n
CONFIG_TFS_DEBUG=y
CONFIG_IDTFS_CRYPTO=y
CONFIG_TFS_SE_FACTORY=syno
CONFIG_TFS_SE_VERSION=as300
CONFIG_TFS_SE_LIB=libtfshal.a
#CONFIG_TFS_EMULATE_ID2_INDEX=9

## target building independently configs
CONFIG_TARGET_ROOT_PATH=linuxhost

## yoc debug configs
CONFIG_YOC_DEBUG_MEMORY=y
CONFIG_YOC_DEBUG_MEMORY_DUMP=n
CONFIG_LOGMACRO_SILENT=n
CONFIG_LOGMACRO_DETAILS=y

## yoc test configs
CONFIG_YOC_ONLINE=y
CONFIG_YOC_UT=y

## yoc md5
CONFIG_YOC_MD5=y

## rhino mm region config
CONFIG_YOS_RHINO_MMREGION=y
```
